// SPDX-License-Identifier: (GPL-2.0 OR MIT)
/*
 * TH1520 VC8000D V4L2 解码器的示例设备树节点。
 *
 * !!! 这些地址与中断号都是**待硬件验证**的，必须在目标板上核对 !!!
 *
 * 证据来源：
 *
 *  - 子系统基址 0xff_ecc0_0000
 *    reference/vpu-vc8000d-kernel/linux/subsys_driver/subsys.c
 *        struct SubsysDesc subsys_array[] = { {0, 0, 0xffecc00000} };
 *
 *  - VC8000D 解码核在子系统基址 + 0x1000，寄存器窗口 1023 * 4 字节
 *    同文件 struct CoreDesc core_array[]:
 *        {0, 0, HW_VC8000D, 0x1000, 1023*4, -1, 0}
 *    厂商驱动用 multicorebase[i] = base_addr + submodule_offset[HW_VC8000D]
 *    得到实际寄存器基址。
 *
 *  - 时钟名 cclk / aclk / pclk
 *    reference/vpu-vc8000d-kernel/linux/subsys_driver/hantro_dec.c
 *        devm_clk_get(&pdev->dev, "cclk" / "aclk" / "pclk")
 *
 *  - 中断由 platform_get_irq(pdev, 0) 获取（同文件 probe）。
 *    厂商 DT 里的具体 GIC 号本仓库没有资料，下面用 <占位> 标出。
 *
 * 与厂商 DT 节点的区别（重要）：
 *   厂商 hantrodec 驱动把 reg 当作**子系统基址**，自己再加 0x1000。
 *   本驱动的 reg 直接指向 VC8000D 解码核，避免在代码里藏一个魔数偏移。
 *   因此本驱动使用独立的 compatible "xuantie,th1520-vc8000d-v4l2"，
 *   不会和仍在使用 "xuantie,th1520-vc8000d" 的厂商节点抢同一个设备。
 *
 * 使用前必须确认：
 *   1. 厂商 hantrodec.ko 没有同时加载（两者会争抢同一片寄存器）。
 *   2. CMA 池位于 4 GiB 以下 —— 驱动当前把 DMA 掩码限制为 32 bit，
 *      理由见 driver/README.md 的“地址位宽”一节。
 */

/dts-v1/;
/plugin/;

&{/soc} {
	vpu_dec: video-codec@ffecc01000 {
		compatible = "xuantie,th1520-vc8000d-v4l2";

		/* 子系统基址 0xffecc00000 + VC8000D 偏移 0x1000 */
		reg = <0xff 0xecc01000 0x0 0x1000>;

		interrupt-parent = <&plic>;
		interrupts = <0 /* <占位：待从目标板 DT 或 datasheet 确认> */>;

		clocks = <&vpsys_clk 0>, <&vpsys_clk 1>, <&vpsys_clk 2>;
		clock-names = "cclk", "aclk", "pclk";

		power-domains = <&pd_vpu>;

		status = "okay";
	};
};
